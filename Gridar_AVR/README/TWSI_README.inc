// ДАННЫЙ МОДУЛЬ НАПИСАН ДЛЯ работы по протоколу Two wires (TWSI)

// Настройки модуля
/*
* -----------------------------------------------------------------------------------------------
* Все настройки выполняются в файле (TWSI_config.inc) в папке (Configs)
* Указываем скорость передачи по TWSI
* -----------------------------------------------------------------------------------------------
*
* Для начала работы запускаем протокол 
* - TWSI_START [адрес_устройства ($04 - например)], [Чтение_или_запись]
* Запись - 'W'
* Чтение - 'R'
* 
* Отправляем байт (если запись)
* - TWSI_Sending_byte [регистр_для_передачи]
*
* Читаем байт (если чтение)
* - TWSI_Reading_byte [регистр_куда_запишем]
*
* Останавливаем протокол
* - TWSI_STOP
*/
