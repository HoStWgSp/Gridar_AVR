#define MUXMUX4
#define SRBMUX5
.macro ChannelSelection
	.if @0 != null
		SingleEnded @0
	.else
		Differential @1, @2, @3
	.endif
.endm
.macro SingleEnded
	.if @0 == ADC0
		.equ ADMUXMUX0 = 0
		.equ ADMUXMUX1 = 0
		.equ ADMUXMUX2 = 0
		.equ ADMUXMUX3 = 0
		.equ ADMUXMUX4 = 0
		.equ ADCSRBMUX5 = 0
	.elif @0 == ADC1
		.equ ADMUXMUX0 = 1
		.equ ADMUXMUX1 = 0
		.equ ADMUXMUX2 = 0
		.equ ADMUXMUX3 = 0
		.equ ADMUXMUX4 = 0
		.equ ADCSRBMUX5 = 0
	.elif @0 == ADC2
		.equ ADMUXMUX0 = 0
		.equ ADMUXMUX1 = 1
		.equ ADMUXMUX2 = 0
		.equ ADMUXMUX3 = 0
		.equ ADMUXMUX4 = 0
		.equ ADCSRBMUX5 = 0
	.elif @0 == ADC3
		.equ ADMUXMUX0 = 1
		.equ ADMUXMUX1 = 1
		.equ ADMUXMUX2 = 0
		.equ ADMUXMUX3 = 0
		.equ ADMUXMUX4 = 0
		.equ ADCSRBMUX5 = 0
	.elif @0 == ADC4
		.equ ADMUXMUX0 = 0
		.equ ADMUXMUX1 = 0
		.equ ADMUXMUX2 = 1
		.equ ADMUXMUX3 = 0
		.equ ADMUXMUX4 = 0
		.equ ADCSRBMUX5 = 0
	.elif @0 == ADC5
		.equ ADMUXMUX0 = 1
		.equ ADMUXMUX1 = 0
		.equ ADMUXMUX2 = 1
		.equ ADMUXMUX3 = 0
		.equ ADMUXMUX4 = 0
		.equ ADCSRBMUX5 = 0
	.elif @0 == ADC6
		.equ ADMUXMUX0 = 0
		.equ ADMUXMUX1 = 1
		.equ ADMUXMUX2 = 1
		.equ ADMUXMUX3 = 0
		.equ ADMUXMUX4 = 0
		.equ ADCSRBMUX5 = 0
	.elif @0 == ADC7
		.equ ADMUXMUX0 = 1
		.equ ADMUXMUX1 = 1
		.equ ADMUXMUX2 = 1
		.equ ADMUXMUX3 = 0
		.equ ADMUXMUX4 = 0
		.equ ADCSRBMUX5 = 0
	.elif @0 == ADC8
		.equ ADMUXMUX0 = 0
		.equ ADMUXMUX1 = 0
		.equ ADMUXMUX2 = 0
		.equ ADMUXMUX3 = 0
		.equ ADMUXMUX4 = 0
		.equ ADCSRBMUX5 = 1
	.elif @0 == ADC9
		.equ ADMUXMUX0 = 1
		.equ ADMUXMUX1 = 0
		.equ ADMUXMUX2 = 0
		.equ ADMUXMUX3 = 0
		.equ ADMUXMUX4 = 0
		.equ ADCSRBMUX5 = 1
	.elif @0 == ADC10
		.equ ADMUXMUX0 = 0
		.equ ADMUXMUX1 = 1
		.equ ADMUXMUX2 = 0
		.equ ADMUXMUX3 = 0
		.equ ADMUXMUX4 = 0
		.equ ADCSRBMUX5 = 1
	.elif @0 == ADC11
		.equ ADMUXMUX0 = 1
		.equ ADMUXMUX1 = 1
		.equ ADMUXMUX2 = 0
		.equ ADMUXMUX3 = 0
		.equ ADMUXMUX4 = 0
		.equ ADCSRBMUX5 = 1
	.elif @0 == ADC12
		.equ ADMUXMUX0 = 0
		.equ ADMUXMUX1 = 0
		.equ ADMUXMUX2 = 1
		.equ ADMUXMUX3 = 0
		.equ ADMUXMUX4 = 0
		.equ ADCSRBMUX5 = 1
	.elif @0 == ADC13
		.equ ADMUXMUX0 = 1
		.equ ADMUXMUX1 = 0
		.equ ADMUXMUX2 = 1
		.equ ADMUXMUX3 = 0
		.equ ADMUXMUX4 = 0
		.equ ADCSRBMUX5 = 1
	.elif @0 == ADC14
		.equ ADMUXMUX0 = 0
		.equ ADMUXMUX1 = 1
		.equ ADMUXMUX2 = 1
		.equ ADMUXMUX3 = 0
		.equ ADMUXMUX4 = 0
		.equ ADCSRBMUX5 = 1
	.elif @0 == ADC15
		.equ ADMUXMUX0 = 1
		.equ ADMUXMUX1 = 1
		.equ ADMUXMUX2 = 1
		.equ ADMUXMUX3 = 0
		.equ ADMUXMUX4 = 0
		.equ ADCSRBMUX5 = 1
	.elif @0 == V1
		.equ ADMUXMUX0 = 0
		.equ ADMUXMUX1 = 1
		.equ ADMUXMUX2 = 1
		.equ ADMUXMUX3 = 1
		.equ ADMUXMUX4 = 1
		.equ ADCSRBMUX5 = 0
	.elif @0 == V0
		.equ ADMUXMUX0 = 1
		.equ ADMUXMUX1 = 1
		.equ ADMUXMUX2 = 1
		.equ ADMUXMUX3 = 1
		.equ ADMUXMUX4 = 1
		.equ ADCSRBMUX5 = 0
	.endif
.endm
.macro Differential
	.if @1 == ADC0
		.if @2 == 10
			.if @0 == ADC0
				.equ ADMUXMUX0 = 0
				.equ ADMUXMUX1 = 0
				.equ ADMUXMUX2 = 0
				.equ ADMUXMUX3 = 1
				.equ ADMUXMUX4 = 0
				.equ ADCSRBMUX5 = 0
			.elif @0 == ADC1
				.equ ADMUXMUX0 = 1
				.equ ADMUXMUX1 = 0
				.equ ADMUXMUX2 = 0
				.equ ADMUXMUX3 = 1
				.equ ADMUXMUX4 = 0
				.equ ADCSRBMUX5 = 0
			.endif
		.elif @2 == 200
			.if @0 == ADC0
				.equ ADMUXMUX0 = 0
				.equ ADMUXMUX1 = 1
				.equ ADMUXMUX2 = 0
				.equ ADMUXMUX3 = 1
				.equ ADMUXMUX4 = 0
				.equ ADCSRBMUX5 = 0
			.elif @0 == ADC1
				.equ ADMUXMUX0 = 1
				.equ ADMUXMUX1 = 1
				.equ ADMUXMUX2 = 0
				.equ ADMUXMUX3 = 1
				.equ ADMUXMUX4 = 0
				.equ ADCSRBMUX5 = 0
			.endif
		.endif
	.elif @1 == ADC1
		.if @2 == 1
			.if @0 == ADC0
				.equ ADMUXMUX0 = 0
				.equ ADMUXMUX1 = 0
				.equ ADMUXMUX2 = 0
				.equ ADMUXMUX3 = 0
				.equ ADMUXMUX4 = 1
				.equ ADCSRBMUX5 = 0
			.elif @0 == ADC1
				.equ ADMUXMUX0 = 1
				.equ ADMUXMUX1 = 0
				.equ ADMUXMUX2 = 0
				.equ ADMUXMUX3 = 0
				.equ ADMUXMUX4 = 1
				.equ ADCSRBMUX5 = 0
			.elif @0 == ADC2
				.equ ADMUXMUX0 = 0
				.equ ADMUXMUX1 = 1
				.equ ADMUXMUX2 = 0
				.equ ADMUXMUX3 = 0
				.equ ADMUXMUX4 = 1
				.equ ADCSRBMUX5 = 0
			.elif @0 == ADC3
				.equ ADMUXMUX0 = 1
				.equ ADMUXMUX1 = 1
				.equ ADMUXMUX2 = 0
				.equ ADMUXMUX3 = 0
				.equ ADMUXMUX4 = 1
				.equ ADCSRBMUX5 = 0
			.elif @0 == ADC4
				.equ ADMUXMUX0 = 0
				.equ ADMUXMUX1 = 0
				.equ ADMUXMUX2 = 1
				.equ ADMUXMUX3 = 0
				.equ ADMUXMUX4 = 1
				.equ ADCSRBMUX5 = 0
			.elif @0 == ADC5
				.equ ADMUXMUX0 = 1
				.equ ADMUXMUX1 = 0
				.equ ADMUXMUX2 = 1
				.equ ADMUXMUX3 = 0
				.equ ADMUXMUX4 = 1
				.equ ADCSRBMUX5 = 0
			.elif @0 == ADC6
				.equ ADMUXMUX0 = 0
				.equ ADMUXMUX1 = 1
				.equ ADMUXMUX2 = 1
				.equ ADMUXMUX3 = 0
				.equ ADMUXMUX4 = 1
				.equ ADCSRBMUX5 = 0
			.elif @0 == ADC7
				.equ ADMUXMUX0 = 1
				.equ ADMUXMUX1 = 1
				.equ ADMUXMUX2 = 1
				.equ ADMUXMUX3 = 0
				.equ ADMUXMUX4 = 1
				.equ ADCSRBMUX5 = 0
			.endif
		.endif
	.elif @1 == ADC2
		.if @2 == 1
			.if @0 == ADC0
				.equ ADMUXMUX0 = 0
				.equ ADMUXMUX1 = 0
				.equ ADMUXMUX2 = 0
				.equ ADMUXMUX3 = 1
				.equ ADMUXMUX4 = 1
				.equ ADCSRBMUX5 = 0
			.elif @0 == ADC1
				.equ ADMUXMUX0 = 1
				.equ ADMUXMUX1 = 0
				.equ ADMUXMUX2 = 0
				.equ ADMUXMUX3 = 1
				.equ ADMUXMUX4 = 1
				.equ ADCSRBMUX5 = 0
			.elif @0 == ADC2
				.equ ADMUXMUX0 = 0
				.equ ADMUXMUX1 = 1
				.equ ADMUXMUX2 = 0
				.equ ADMUXMUX3 = 1
				.equ ADMUXMUX4 = 1
				.equ ADCSRBMUX5 = 0
			.elif @0 == ADC3
				.equ ADMUXMUX0 = 1
				.equ ADMUXMUX1 = 1
				.equ ADMUXMUX2 = 0
				.equ ADMUXMUX3 = 1
				.equ ADMUXMUX4 = 1
				.equ ADCSRBMUX5 = 0
			.elif @0 == ADC4
				.equ ADMUXMUX0 = 0
				.equ ADMUXMUX1 = 0
				.equ ADMUXMUX2 = 1
				.equ ADMUXMUX3 = 1
				.equ ADMUXMUX4 = 1
				.equ ADCSRBMUX5 = 0
			.elif @0 == ADC5
				.equ ADMUXMUX0 = 1
				.equ ADMUXMUX1 = 0
				.equ ADMUXMUX2 = 1
				.equ ADMUXMUX3 = 1
				.equ ADMUXMUX4 = 1
				.equ ADCSRBMUX5 = 0
			.endif
		.elif @2 == 10
			.if @0 == ADC2
				.equ ADMUXMUX0 = 0
				.equ ADMUXMUX1 = 0
				.equ ADMUXMUX2 = 1
				.equ ADMUXMUX3 = 1
				.equ ADMUXMUX4 = 0
				.equ ADCSRBMUX5 = 0
			.elif @0 == ADC3
				.equ ADMUXMUX0 = 1
				.equ ADMUXMUX1 = 0
				.equ ADMUXMUX2 = 1
				.equ ADMUXMUX3 = 1
				.equ ADMUXMUX4 = 0
				.equ ADCSRBMUX5 = 0
			.endif
		.elif @2 == 200
			.if @0 == ADC2
				.equ ADMUXMUX0 = 0
				.equ ADMUXMUX1 = 1
				.equ ADMUXMUX2 = 1
				.equ ADMUXMUX3 = 1
				.equ ADMUXMUX4 = 0
				.equ ADCSRBMUX5 = 0
			.elif @0 == ADC3
				.equ ADMUXMUX0 = 1
				.equ ADMUXMUX1 = 1
				.equ ADMUXMUX2 = 1
				.equ ADMUXMUX3 = 1
				.equ ADMUXMUX4 = 0
				.equ ADCSRBMUX5 = 0
			.endif
		.endif
	.elif @1 == ADC8
		.if @2 == 10
			.if @0 == ADC8
				.equ ADMUXMUX0 = 0
				.equ ADMUXMUX1 = 0
				.equ ADMUXMUX2 = 0
				.equ ADMUXMUX3 = 1
				.equ ADMUXMUX4 = 0
				.equ ADCSRBMUX5 = 1
			.elif @0 == ADC9
				.equ ADMUXMUX0 = 1
				.equ ADMUXMUX1 = 0
				.equ ADMUXMUX2 = 0
				.equ ADMUXMUX3 = 1
				.equ ADMUXMUX4 = 0
				.equ ADCSRBMUX5 = 1
			.endif
		.elif @2 == 200
			.if @0 == ADC8
				.equ ADMUXMUX0 = 0
				.equ ADMUXMUX1 = 1
				.equ ADMUXMUX2 = 0
				.equ ADMUXMUX3 = 1
				.equ ADMUXMUX4 = 0
				.equ ADCSRBMUX5 = 1
			.elif @0 == ADC9
				.equ ADMUXMUX0 = 1
				.equ ADMUXMUX1 = 1
				.equ ADMUXMUX2 = 0
				.equ ADMUXMUX3 = 1
				.equ ADMUXMUX4 = 0
				.equ ADCSRBMUX5 = 1
			.endif
		.endif
	.elif @1 == ADC9
		.if @2 == 1
			.if @0 == ADC8
				.equ ADMUXMUX0 = 0
				.equ ADMUXMUX1 = 0
				.equ ADMUXMUX2 = 0
				.equ ADMUXMUX3 = 0
				.equ ADMUXMUX4 = 1
				.equ ADCSRBMUX5 = 1
			.elif @0 == ADC9
				.equ ADMUXMUX0 = 1
				.equ ADMUXMUX1 = 0
				.equ ADMUXMUX2 = 0
				.equ ADMUXMUX3 = 0
				.equ ADMUXMUX4 = 1
				.equ ADCSRBMUX5 = 1
			.elif @0 == ADC10
				.equ ADMUXMUX0 = 0
				.equ ADMUXMUX1 = 1
				.equ ADMUXMUX2 = 0
				.equ ADMUXMUX3 = 0
				.equ ADMUXMUX4 = 1
				.equ ADCSRBMUX5 = 1
			.elif @0 == ADC11
				.equ ADMUXMUX0 = 1
				.equ ADMUXMUX1 = 1
				.equ ADMUXMUX2 = 0
				.equ ADMUXMUX3 = 0
				.equ ADMUXMUX4 = 1
				.equ ADCSRBMUX5 = 1
			.elif @0 == ADC12
				.equ ADMUXMUX0 = 0
				.equ ADMUXMUX1 = 0
				.equ ADMUXMUX2 = 1
				.equ ADMUXMUX3 = 0
				.equ ADMUXMUX4 = 1
				.equ ADCSRBMUX5 = 1
			.elif @0 == ADC13
				.equ ADMUXMUX0 = 1
				.equ ADMUXMUX1 = 0
				.equ ADMUXMUX2 = 1
				.equ ADMUXMUX3 = 0
				.equ ADMUXMUX4 = 1
				.equ ADCSRBMUX5 = 1
			.elif @0 == ADC14
				.equ ADMUXMUX0 = 0
				.equ ADMUXMUX1 = 1
				.equ ADMUXMUX2 = 1
				.equ ADMUXMUX3 = 0
				.equ ADMUXMUX4 = 1
				.equ ADCSRBMUX5 = 1
			.elif @0 == ADC15
				.equ ADMUXMUX0 = 1
				.equ ADMUXMUX1 = 1
				.equ ADMUXMUX2 = 1
				.equ ADMUXMUX3 = 0
				.equ ADMUXMUX4 = 1
				.equ ADCSRBMUX5 = 1
			.endif
		.endif
	.elif @1 == ADC10
		.if @2 == 1
			.if @0 == ADC8
				.equ ADMUXMUX0 = 0
				.equ ADMUXMUX1 = 0
				.equ ADMUXMUX2 = 0
				.equ ADMUXMUX3 = 1
				.equ ADMUXMUX4 = 1
				.equ ADCSRBMUX5 = 1
			.elif @0 == ADC9
				.equ ADMUXMUX0 = 1
				.equ ADMUXMUX1 = 0
				.equ ADMUXMUX2 = 0
				.equ ADMUXMUX3 = 1
				.equ ADMUXMUX4 = 1
				.equ ADCSRBMUX5 = 1
			.elif @0 == ADC10
				.equ ADMUXMUX0 = 0
				.equ ADMUXMUX1 = 1
				.equ ADMUXMUX2 = 0
				.equ ADMUXMUX3 = 1
				.equ ADMUXMUX4 = 1
				.equ ADCSRBMUX5 = 1
			.elif @0 == ADC11
				.equ ADMUXMUX0 = 1
				.equ ADMUXMUX1 = 1
				.equ ADMUXMUX2 = 0
				.equ ADMUXMUX3 = 1
				.equ ADMUXMUX4 = 1
				.equ ADCSRBMUX5 = 1
			.elif @0 == ADC12
				.equ ADMUXMUX0 = 0
				.equ ADMUXMUX1 = 0
				.equ ADMUXMUX2 = 1
				.equ ADMUXMUX3 = 1
				.equ ADMUXMUX4 = 1
				.equ ADCSRBMUX5 = 1
			.elif @0 == ADC13
				.equ ADMUXMUX0 = 1
				.equ ADMUXMUX1 = 0
				.equ ADMUXMUX2 = 1
				.equ ADMUXMUX3 = 1
				.equ ADMUXMUX4 = 1
				.equ ADCSRBMUX5 = 1
			.endif
		.elif @2 == 10
			.if @0 == ADC10
				.equ ADMUXMUX0 = 0
				.equ ADMUXMUX1 = 0
				.equ ADMUXMUX2 = 1
				.equ ADMUXMUX3 = 1
				.equ ADMUXMUX4 = 0
				.equ ADCSRBMUX5 = 1
			.elif @0 == ADC11
				.equ ADMUXMUX0 = 1
				.equ ADMUXMUX1 = 0
				.equ ADMUXMUX2 = 1
				.equ ADMUXMUX3 = 1
				.equ ADMUXMUX4 = 0
				.equ ADCSRBMUX5 = 1
			.endif
		.elif @2 == 200
			.if @0 == ADC10
				.equ ADMUXMUX0 = 0
				.equ ADMUXMUX1 = 1
				.equ ADMUXMUX2 = 1
				.equ ADMUXMUX3 = 1
				.equ ADMUXMUX4 = 0
				.equ ADCSRBMUX5 = 1
			.elif @0 == ADC11
				.equ ADMUXMUX0 = 1
				.equ ADMUXMUX1 = 1
				.equ ADMUXMUX2 = 1
				.equ ADMUXMUX3 = 1
				.equ ADMUXMUX4 = 0
				.equ ADCSRBMUX5 = 1
			.endif
		.endif
	.endif
.endm
