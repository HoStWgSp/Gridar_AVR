
.include "Main/Interrupts/Vectors8.inc"
.include "Main/Interrupts/Vectors16.inc"
.include "Main/Interrupts/Vectors32.inc"
.include "Main/Interrupts/Vectors48_88_168.inc"
.include "Main/Interrupts/Vectors64.inc"
.include "Main/Interrupts/Vectors128.inc"
.include "Main/Interrupts/Vectors162.inc"
.include "Main/Interrupts/Vectors164_324_644.inc"
.include "Main/Interrupts/Vectors165.inc"
.include "Main/Interrupts/Vectors169.inc"
.include "Main/Interrupts/Vectors325_3250_645_6450.inc"
.include "Main/Interrupts/Vectors328.inc"
.include "Main/Interrupts/Vectors329_3290_649_6490.inc"
.include "Main/Interrupts/Vectors640_1280_1281_2560_2561.inc"
.include "Main/Interrupts/Vectors1284.inc"
.include "Main/Interrupts/Vectors8515.inc"
.include "Main/Interrupts/Vectors8535.inc"
