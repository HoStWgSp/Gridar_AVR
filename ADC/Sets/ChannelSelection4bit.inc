.macro ChannelSelection
	.if @0 == ADC0
		.equ ADMUXMUX0 = 0
		.equ ADMUXMUX1 = 0
		.equ ADMUXMUX2 = 0
		.equ ADMUXMUX3 = 0
	.elif @0 == ADC1
		.equ ADMUXMUX0 = 1
		.equ ADMUXMUX1 = 0
		.equ ADMUXMUX2 = 0
		.equ ADMUXMUX3 = 0
	.elif @0 == ADC2
		.equ ADMUXMUX0 = 0
		.equ ADMUXMUX1 = 1
		.equ ADMUXMUX2 = 0
		.equ ADMUXMUX3 = 0
	.elif @0 == ADC3
		.equ ADMUXMUX0 = 1
		.equ ADMUXMUX1 = 1
		.equ ADMUXMUX2 = 0
		.equ ADMUXMUX3 = 0
	.elif @0 == ADC4
		.equ ADMUXMUX0 = 0
		.equ ADMUXMUX1 = 0
		.equ ADMUXMUX2 = 1
		.equ ADMUXMUX3 = 0
	.elif @0 == ADC5
		.equ ADMUXMUX0 = 1
		.equ ADMUXMUX1 = 0
		.equ ADMUXMUX2 = 1
		.equ ADMUXMUX3 = 0
	.elif @0 == ADC6
		.equ ADMUXMUX0 = 0
		.equ ADMUXMUX1 = 1
		.equ ADMUXMUX2 = 1
		.equ ADMUXMUX3 = 0
	.elif @0 == ADC7
		.equ ADMUXMUX0 = 1
		.equ ADMUXMUX1 = 1
		.equ ADMUXMUX2 = 1
		.equ ADMUXMUX3 = 0
	.elif @0 == ADC8
		.equ ADMUXMUX0 = 0
		.equ ADMUXMUX1 = 0
		.equ ADMUXMUX2 = 0
		.equ ADMUXMUX3 = 1
	.elif @0 == V1
		.equ ADMUXMUX0 = 0
		.equ ADMUXMUX1 = 1
		.equ ADMUXMUX2 = 1
		.equ ADMUXMUX3 = 1
	.elif @0 == V0
		.equ ADMUXMUX0 = 1
		.equ ADMUXMUX1 = 1
		.equ ADMUXMUX2 = 1
		.equ ADMUXMUX3 = 1
	.endif
.endm
